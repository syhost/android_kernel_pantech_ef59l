## drivers/video/msm/mhl/sii8240/Kconfig
```kconfig
config SII8240_MHL_TX 
	tristate
	prompt "Silicon Image Wolverine 60 to MHL tx"
	depends on I2C 
        default n 

config MHL_RETRY_FULL
	bool
	depends on SII8240_MHL_TX
        default n
```
